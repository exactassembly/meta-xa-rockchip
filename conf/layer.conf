## conf/layer.conf
```bitbake
# We have a conf and classes directory, append to BBPATH
BBPATH .= ":${LAYERDIR}"

# We have a recipes directory, add to BBFILES
BBFILES += "${LAYERDIR}/recipes*/*/*.bb ${LAYERDIR}/recipes*/*/*.bbappend"

BBFILE_COLLECTIONS += "meta-xa-rockchip"
BBFILE_PATTERN_meta-xa-rockchip := "^${LAYERDIR}/"

LAYERSERIES_COMPAT_meta-xa-rockchip = "mickledore"
```

## conf/machine/firefly-px30.conf
```bitbake
#@TYPE: Machine
#@NAME: FIREFLY PX30

require conf/machine/include/px30.inc


RK_KERNEL_DEVICETREE_PREFIX = "rockchip/"
RK_KERNEL_DEVICETREE = "firefly-px30.dtb"

KERNEL_DEVICETREE = "${RK_KERNEL_DEVICETREE_PREFIX}${RK_KERNEL_DEVICETREE}"
UBOOT_MACHINE = "firefly-px30_defconfig"

SERIAL_CONSOLES = "115200;ttyS2"

WKS_FILE = "px30.wks"
```
